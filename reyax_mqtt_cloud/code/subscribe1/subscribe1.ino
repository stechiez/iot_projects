#include "arduino_secrets.h"
#include <ArduinoMqttClient.h>
#include <ESP8266WiFi.h>


#include <Wire.h>
#include <Adafruit_GFX.h>
#include <Adafruit_SSD1306.h>

WiFiClient wifiClient;
MqttClient mqttClient(wifiClient);
int count = 0;

#define SCREEN_WIDTH 128 // OLED display width, in pixels
#define SCREEN_HEIGHT 64 // OLED display height, in pixels

// Declaration for an SSD1306 display connected to I2C (SDA, SCL pins)
#define OLED_RESET     -1 // Reset pin # (or -1 if sharing Arduino reset pin)
Adafruit_SSD1306 display(SCREEN_WIDTH, SCREEN_HEIGHT, &Wire, OLED_RESET);

#define NUMFLAKES     10 // Number of snowflakes in the animation example

#define LOGO_HEIGHT   16
#define LOGO_WIDTH    16

char rcvd_msg[32];
int msd_index;

static const uint8_t image_data_Image[1024] = {
    0x00, 0x00, 0x00, 0x00, 0x00, 0x00, 0x00, 0x00, 0x00, 0x00, 0x00, 0x00, 0x00, 0x00, 0x00, 0x00, 
    0x00, 0x00, 0x00, 0x00, 0x00, 0x00, 0x00, 0x00, 0x00, 0x00, 0x00, 0x00, 0x00, 0x00, 0x00, 0x00, 
    0x00, 0x00, 0x00, 0x00, 0x00, 0x00, 0x00, 0x00, 0x00, 0x00, 0x00, 0x00, 0x00, 0x00, 0x00, 0x00, 
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    0x00, 0x00, 0x00, 0x00, 0x00, 0x00, 0x00, 0x00, 0x00, 0x00, 0x00, 0x00, 0x00, 0x00, 0x00, 0x00
};

void testdrawstyles(String str) {
  display.clearDisplay();

  display.setTextSize(2);             // Normal 1:1 pixel scale
  display.setTextColor(SSD1306_WHITE);        // Draw white text
  display.setCursor(0,0);             // Start at top-left corner
//  display.println(F("GSheet C2:"));
//  display.setCursor(0,1);             // Start at top-left corner
  display.println(str.c_str());
  display.display();
  delay(2000);
}

void setup() {
    Serial.begin(9600);

        // SSD1306_SWITCHCAPVCC = generate display voltage from 3.3V internally
  if(!display.begin(SSD1306_SWITCHCAPVCC, 0x3C)) { // Address 0x3D for 128x64
    Serial.println(F("SSD1306 allocation failed"));
    for(;;); // Don't proceed, loop forever
  }
  display.clearDisplay();
  display.drawBitmap(0, 0, image_data_Image, 128, 64, 1);
  display.display();
  delay(2000); // Pause for 2 seconds
  display.clearDisplay();


    WiFi.begin(WIFI_SSID, WIFI_PASS);
    while(WiFi.status() != WL_CONNECTED){
        Serial.print("."); 
        delay(500);
    }
    Serial.println("Connected to WiFi!");
    mqttClient.setId(MQTT_CLID);
    mqttClient.setUsernamePassword(MQTT_USER, MQTT_PASS);
    if (!mqttClient.connect(MQTT_BROKER, MQTT_PORT)){
        Serial.println(mqttClient.connectError());
    }
    Serial.println("Connected to MQTT Cloud!");
    mqttClient.subscribe(MQTT_TOPIC);
    testdrawstyles("STechiezDIY");
}


void loop() {
  int messageSize = mqttClient.parseMessage();
  msd_index = 0;
  memset(rcvd_msg,'\0',32);
  if (messageSize) {
    // we received a message, print out the topic and contents
    Serial.print("Received a message with topic '");
    Serial.print(mqttClient.messageTopic());
    Serial.print("', length ");
    Serial.print(messageSize);
    Serial.println(" bytes:");

    // use the Stream interface to print the contents
    while (mqttClient.available()) {
      rcvd_msg[msd_index++] = (char)mqttClient.read();
    }
    rcvd_msg[msd_index++] = '\0';
    String message(rcvd_msg);
    Serial.println(message);
    testdrawstyles(message);
  }
}
